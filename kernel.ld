/* ============================================================================
 * 链接脚本 - kernel.ld
 * ============================================================================
 * 链接脚本的作用：告诉链接器（ld）如何把多个 .o 文件合并成最终的内核镜像
 * 它决定了：代码放在内存的哪个地址、数据放在哪里、入口点是什么
 * 就像一张建筑蓝图，告诉工人每块砖头该砌在哪里
 * ============================================================================ */

/* ----------------------------------------------------------------------------
 * 输出架构设置
 * ---------------------------------------------------------------------------- */
/* OUTPUT_ARCH：指定生成的可执行文件是为哪个CPU架构设计的
 * riscv：RISC-V 架构（32位或64位，具体由后面的设置决定） */
OUTPUT_ARCH(riscv)

/* ----------------------------------------------------------------------------
 * 入口点设置
 * ---------------------------------------------------------------------------- */
/* ENTRY：指定程序的入口点（程序开始执行的第一条指令的符号名）
 * _start 是在 boot/start.S 中定义的全局标签
 * CPU上电后，会跳转到这个地址开始执行 */
ENTRY(_start)

/* 定义栈顶地址（直接给一个固定值）*/
/* _stack_top = 0x80210002;内核代码从 0x80200000 开始，留出64KB给代码+数据 */

/* ----------------------------------------------------------------------------
 * 内存布局（SECTIONS 命令）
 * ---------------------------------------------------------------------------- */
/* SECTIONS：定义如何把输入段（.text, .data, .bss 等）映射到输出文件 */
SECTIONS
{
    /* ------------------------------------------------------------------------
     * 代码段（.text）
     * ------------------------------------------------------------------------ */
    /* . = 0x80200000; 意思是：当前位置计数器设置为 0x80200000
     * 0x80200000 是 QEMU virt 平台约定的内核加载地址
     * 为什么是 0x80200000 而不是 0x80000000？
     * - 0x80000000 是 OpenSBI（固件）的地址
     * - 0x80200000 是留给内核的空间（OpenSBI 之后 2MB）
     * 所有后续地址都会从这个基址开始累加 */
    . = 0x80200000;

    /* .text : { ... } 定义一个名为 .text 的输出段
     * *(.text) 意思是：把所有输入文件中的 .text 段都放进来
     * .text 段存放的是程序代码（机器指令） */
    .text : {
        *(.text)
    }

    /* ------------------------------------------------------------------------
     * 只读数据段（.rodata）
     * ------------------------------------------------------------------------ */
    /* .rodata 存放只读数据，比如字符串常量 "Hello World\n"
     * 这些数据在程序运行期间不能被修改 */
    .rodata : {
        *(.rodata)
    }

    /* ------------------------------------------------------------------------
     * 数据段（.data）
     * ------------------------------------------------------------------------ */
    /* .data 存放已初始化的全局变量和静态变量
     * 例如：int x = 5; 这个 5 就存在 .data 段里 */
    .data : {
        *(.data)
    }

    /* ------------------------------------------------------------------------
     * BSS段（.bss）
     * ------------------------------------------------------------------------ */
    /* .bss 存放未初始化的全局变量和静态变量
     * 例如：int y; 这个 y 就存在 .bss 段里（不占文件空间，但占内存空间）
     * 注意：BSS段的内容在程序启动时应该被清零 */
    .bss : {
        *(.bss)
    }

    /* ------------------------------------------------------------------------
     * 栈段（.stack）
     * ------------------------------------------------------------------------ */
    /* 栈是函数调用时存放局部变量、返回地址的地方
     * 这里手动定义一个栈区域 */
    .stack : {
        /* . = . + 4096; 意思是：当前位置向后移动 4096 字节
         * 4096 字节 = 4KB，这个大小作为内核启动栈
         * 注意：栈是向下增长的（从高地址向低地址），
         * 所以我们把栈顶放在这个区域的末尾 */
        . = . + 4096;
        
        PROVIDE(_stack_top = .);
        /* _stack_top 是一个符号，代表栈顶地址
         * boot/start.S 会用这个地址来设置 sp（栈指针寄存器）
         * PROVIDE 的意思是：如果其他文件没有定义这个符号，就在这里提供它 */
        /* PROVIDE(_stack_top = .);
         */
    }
}
